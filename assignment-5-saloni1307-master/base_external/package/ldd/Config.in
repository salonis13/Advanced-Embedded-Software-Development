## assignment-8-saloni1307-master/base_external/package/aesd-char-driver/Config.in
```kconfig
config BR2_PACKAGE_AESD_CHAR_DRIVER
	bool "aesd-char-driver"
	help
	  Includes the aesd char driver in the kernel image.
	  Used to understand buildroot external trees and package builds.
```

## final-project-saloni1307-master/base_external/Config.in
```kconfig
source "$BR2_EXTERNAL_project_base_PATH/package/aesd-assignments/Config.in"
source "$BR2_EXTERNAL_project_base_PATH/package/dlib/Config.in"
source "$BR2_EXTERNAL_project_base_PATH/package/distro/Config.in"
source "$BR2_EXTERNAL_project_base_PATH/package/wheel/Config.in"
source "$BR2_EXTERNAL_project_base_PATH/package/pyparsing/Config.in"
source "$BR2_EXTERNAL_project_base_PATH/package/sockettest/Config.in"
source "$BR2_EXTERNAL_project_base_PATH/package/qt-thread-updater/Config.in"
source "$BR2_EXTERNAL_project_base_PATH/package/python-face-recognition/Config.in"
source "$BR2_EXTERNAL_project_base_PATH/package/python-face-recognition-models/Config.in"
source "$BR2_EXTERNAL_project_base_PATH/package/python-glob2/Config.in"
source "$BR2_EXTERNAL_project_base_PATH/package/python-gpsdclient/Config.in"
source "$BR2_EXTERNAL_project_base_PATH/package/python-obd/Config.in"
source "$BR2_EXTERNAL_project_base_PATH/package/python-packaging/Config.in"
source "$BR2_EXTERNAL_project_base_PATH/package/python-pyqt5-sip/Config.in"
source "$BR2_EXTERNAL_project_base_PATH/package/python-pyqt-builder/Config.in"
source "$BR2_EXTERNAL_project_base_PATH/package/python-pyqtgraph/Config.in"
source "$BR2_EXTERNAL_project_base_PATH/package/python-qtpy/Config.in"
source "$BR2_EXTERNAL_project_base_PATH/package/python-queuelib/Config.in"
source "$BR2_EXTERNAL_project_base_PATH/package/python-scikit-build/Config.in"
source "$BR2_EXTERNAL_project_base_PATH/package/python-sockets/Config.in"
source "$BR2_EXTERNAL_project_base_PATH/package/python-thread6/Config.in"
source "$BR2_EXTERNAL_project_base_PATH/package/python-threading2/Config.in"
```

## final-project-saloni1307-master/base_external/configs/aesd_rpi_defconfig
```kconfig
BR2_arm=y
BR2_cortex_a53=y
BR2_ARM_FPU_NEON_VFPV4=y
BR2_CCACHE=y
BR2_TOOLCHAIN_BUILDROOT_GLIBC=y
BR2_KERNEL_HEADERS_4_19=y
BR2_BINUTILS_VERSION_2_33_X=y
BR2_TOOLCHAIN_BUILDROOT_CXX=y
BR2_GCC_ENABLE_LTO=y
BR2_GCC_ENABLE_OPENMP=y
BR2_GCC_ENABLE_GRAPHITE=y
BR2_PACKAGE_HOST_GDB=y
BR2_PACKAGE_HOST_GDB_PYTHON=y
BR2_ROOTFS_DEVICE_CREATION_DYNAMIC_MDEV=y
BR2_TARGET_GENERIC_ROOT_PASSWD="root"
BR2_SYSTEM_DHCP="eth0"
BR2_TARGET_TZ_INFO=y
BR2_ROOTFS_OVERLAY="../base_external/rootfs_overlay"
BR2_ROOTFS_POST_BUILD_SCRIPT="board/raspberrypi3/post-build.sh"
BR2_ROOTFS_POST_IMAGE_SCRIPT="../base_external/rootfs_overlay/etc/post-image.sh"
BR2_ROOTFS_POST_SCRIPT_ARGS="--add-I2C"
BR2_LINUX_KERNEL=y
BR2_LINUX_KERNEL_CUSTOM_TARBALL=y
BR2_LINUX_KERNEL_CUSTOM_TARBALL_LOCATION="$(call github,raspberrypi,linux,64d0a9870ac14d5eb5253f67d984ae348eec1393)/linux-64d0a9870ac14d5eb5253f67d984ae348eec1393.tar.gz"
BR2_LINUX_KERNEL_DEFCONFIG="bcm2709"
BR2_LINUX_KERNEL_DTS_SUPPORT=y
BR2_LINUX_KERNEL_INTREE_DTS_NAME="bcm2710-rpi-3-b bcm2710-rpi-3-b-plus bcm2710-rpi-cm3"
BR2_LINUX_KERNEL_NEEDS_HOST_OPENSSL=y
BR2_PACKAGE_BUSYBOX_SHOW_OTHERS=y
BR2_PACKAGE_FFMPEG_FFPLAY=y
BR2_PACKAGE_GZIP=y
BR2_PACKAGE_STRACE=y
BR2_PACKAGE_BINUTILS=y
BR2_PACKAGE_BINUTILS_TARGET=y
BR2_PACKAGE_CMAKE_CTEST=y
BR2_PACKAGE_GIT=y
BR2_PACKAGE_GREP=y
BR2_PACKAGE_MAKE=y
BR2_PACKAGE_CURLFTPFS=y
BR2_PACKAGE_DEJAVU=y
BR2_PACKAGE_LIBERATION=y
BR2_PACKAGE_FSWEBCAM=y
BR2_PACKAGE_FBV=y
BR2_PACKAGE_MESA3D=y
BR2_PACKAGE_MESA3D_GALLIUM_DRIVER_SWRAST=y
BR2_PACKAGE_MESA3D_OPENGL_GLX=y
BR2_PACKAGE_MESA3D_OPENGL_EGL=y
BR2_PACKAGE_MESA3D_OPENGL_ES=y
BR2_PACKAGE_SDL_X11=y
BR2_PACKAGE_SDL_GFX=y
BR2_PACKAGE_SDL_IMAGE_GIF=y
BR2_PACKAGE_SDL_IMAGE_TIFF=y
BR2_PACKAGE_SDL_NET=y
BR2_PACKAGE_SDL_SOUND=y
BR2_PACKAGE_SDL_SOUND_PLAYSOUND=y
BR2_PACKAGE_SDL2_GFX=y
BR2_PACKAGE_SDL2_IMAGE=y
BR2_PACKAGE_SDL2_MIXER=y
BR2_PACKAGE_QT5=y
BR2_PACKAGE_QT5BASE_GUI=y
BR2_PACKAGE_QT5BASE_WIDGETS=y
BR2_PACKAGE_QT5BASE_GIF=y
BR2_PACKAGE_QT5BASE_JPEG=y
BR2_PACKAGE_QT5BASE_PNG=y
BR2_PACKAGE_QT5BASE_ICU=y
BR2_PACKAGE_QT5BASE_TSLIB=y
BR2_PACKAGE_XORG7=y
BR2_PACKAGE_XSERVER_XORG_SERVER=y
BR2_PACKAGE_XLIB_LIBXSCRNSAVER=y
BR2_PACKAGE_XAPP_BITMAP=y
BR2_PACKAGE_XAPP_EDITRES=y
BR2_PACKAGE_XAPP_RGB=y
BR2_PACKAGE_XAPP_SETXKBMAP=y
BR2_PACKAGE_XAPP_SHOWFONT=y
BR2_PACKAGE_XAPP_SMPROXY=y
BR2_PACKAGE_XAPP_TWM=y
BR2_PACKAGE_XAPP_X11PERF=y
BR2_PACKAGE_XAPP_XBACKLIGHT=y
BR2_PACKAGE_XAPP_XCALC=y
BR2_PACKAGE_XAPP_XCLOCK=y
BR2_PACKAGE_XAPP_XDITVIEW=y
BR2_PACKAGE_XAPP_XDM=y
BR2_PACKAGE_XAPP_XEDIT=y
BR2_PACKAGE_XAPP_XEYES=y
BR2_PACKAGE_XAPP_XFD=y
BR2_PACKAGE_XAPP_XFS=y
BR2_PACKAGE_XAPP_XHOST=y
BR2_PACKAGE_XAPP_XINIT=y
BR2_PACKAGE_XAPP_XLOGO=y
BR2_PACKAGE_XAPP_XMESSAGE=y
BR2_PACKAGE_XAPP_XSETMODE=y
BR2_PACKAGE_XAPP_XSETPOINTER=y
BR2_PACKAGE_XAPP_XSETROOT=y
BR2_PACKAGE_XAPP_XWD=y
BR2_PACKAGE_XAPP_XWUD=y
BR2_PACKAGE_XDRIVER_XF86_INPUT_KEYBOARD=y
BR2_PACKAGE_XDRIVER_XF86_INPUT_MOUSE=y
BR2_PACKAGE_XDRIVER_XF86_INPUT_SYNAPTICS=y
BR2_PACKAGE_XDRIVER_XF86_VIDEO_CIRRUS=y
BR2_PACKAGE_XDRIVER_XF86_VIDEO_FBDEV=y
BR2_PACKAGE_XDRIVER_XF86_VIDEO_FBTURBO=y
BR2_PACKAGE_XDRIVER_XF86_VIDEO_I128=y
BR2_PACKAGE_XDRIVER_XF86_VIDEO_NV=y
BR2_PACKAGE_XDRIVER_XF86_VIDEO_R128=y
BR2_PACKAGE_XDRIVER_XF86_VIDEO_VESA=y
BR2_PACKAGE_MIDORI=y
BR2_PACKAGE_PCMANFM=y
BR2_PACKAGE_XTERM=y
BR2_PACKAGE_XVKBD=y
BR2_PACKAGE_OPENBOX=y
BR2_PACKAGE_RPI_BT_FIRMWARE=y
BR2_PACKAGE_RPI_FIRMWARE=y
BR2_PACKAGE_RPI_FIRMWARE_X=y
BR2_PACKAGE_RPI_WIFI_FIRMWARE=y
BR2_PACKAGE_GPSD=y
BR2_PACKAGE_GPSD_CLIENT_DEBUG=y
BR2_PACKAGE_GPSD_GPSCLOCK=y
BR2_PACKAGE_MDEVD=y
BR2_PACKAGE_MINICOM=y
BR2_PACKAGE_RASPI_GPIO=y
BR2_PACKAGE_RNG_TOOLS=y
BR2_PACKAGE_RTC_TOOLS=y
BR2_PACKAGE_SYSSTAT=y
BR2_PACKAGE_PYTHON3=y
BR2_PACKAGE_PYTHON3_PY_PYC=y
BR2_PACKAGE_PYTHON3_BZIP2=y
BR2_PACKAGE_PYTHON3_CURSES=y
BR2_PACKAGE_PYTHON3_SQLITE=y
BR2_PACKAGE_PYTHON3_XZ=y
BR2_PACKAGE_PYTHON_AENUM=y
BR2_PACKAGE_PYTHON_BACKCALL=y
BR2_PACKAGE_PYTHON_DAPHNE=y
BR2_PACKAGE_PYTHON_DJANGO=y
BR2_PACKAGE_PYTHON_DOCUTILS=y
BR2_PACKAGE_PYTHON_JEDI=y
BR2_PACKAGE_PYTHON_JSON_SCHEMA_VALIDATOR=y
BR2_PACKAGE_PYTHON_JSONMODELS=y
BR2_PACKAGE_PYTHON_JSONSCHEMA=y
BR2_PACKAGE_PYTHON_LIBCONFIG=y
BR2_PACKAGE_PYTHON_LIBUSB1=y
BR2_PACKAGE_PYTHON_NETADDR=y
BR2_PACKAGE_PYTHON_NETIFACES=y
BR2_PACKAGE_PYTHON_PEXPECT=y
BR2_PACKAGE_PYTHON_PICKLESHARE=y
BR2_PACKAGE_PYTHON_PIP=y
BR2_PACKAGE_PYTHON_POSIX_IPC=y
BR2_PACKAGE_PYTHON_PROMPT_TOOLKIT=y
BR2_PACKAGE_PYTHON_PYGAME=y
BR2_PACKAGE_PYTHON_PYGAME_IMAGE=y
BR2_PACKAGE_PYTHON_PYGAME_EXAMPLES=y
BR2_PACKAGE_PYTHON_PYGAME_FONT=y
BR2_PACKAGE_PYTHON_PYGAME_MIXER=y
BR2_PACKAGE_PYTHON_PYGAME_MIXER_MUSIC=y
BR2_PACKAGE_PYTHON_PYGMENTS=y
BR2_PACKAGE_PYTHON_PYUSB=y
BR2_PACKAGE_PYTHON_RPI_GPIO=y
BR2_PACKAGE_PYTHON_SERIAL=y
BR2_PACKAGE_PYTHON_TRAITLETS=y
BR2_PACKAGE_PYTHON_URLLIB3=y
BR2_PACKAGE_PYTHON_WRAPT=y
BR2_PACKAGE_TCL=y
BR2_PACKAGE_LIBGSM=y
BR2_PACKAGE_LIBSSH=y
BR2_PACKAGE_LIBSSH_SERVER=y
BR2_PACKAGE_LIBSSH_OPENSSL=y
BR2_PACKAGE_LIBDRM_VC4=y
BR2_PACKAGE_LIBGLADE=y
BR2_PACKAGE_LIBGTK2=y
BR2_PACKAGE_LIBGTK3=y
# BR2_PACKAGE_LIBGTK3_BROADWAY is not set
BR2_PACKAGE_OPENCV3=y
BR2_PACKAGE_OPENCV3_LIB_HIGHGUI=y
BR2_PACKAGE_OPENCV3_WITH_GTK3=y
BR2_PACKAGE_OPENCV3_LIB_OBJDETECT=y
BR2_PACKAGE_OPENCV3_LIB_PYTHON=y
BR2_PACKAGE_OPENCV3_LIB_VIDEOSTAB=y
BR2_PACKAGE_OPENCV3_WITH_FFMPEG=y
BR2_PACKAGE_OPENCV3_WITH_JASPER=y
BR2_PACKAGE_OPENCV3_WITH_JPEG=y
BR2_PACKAGE_OPENCV3_WITH_PNG=y
BR2_PACKAGE_OPENCV3_WITH_TIFF=y
BR2_PACKAGE_OPENCV3_WITH_V4L=y
BR2_PACKAGE_BCM2835=y
BR2_PACKAGE_LIBGPHOTO2=y
BR2_PACKAGE_LIBGPIOD=y
BR2_PACKAGE_LIBGPIOD_TOOLS=y
BR2_PACKAGE_LIBUSB_EXAMPLES=y
BR2_PACKAGE_LIBUSB_COMPAT=y
BR2_PACKAGE_LIBV4L=y
BR2_PACKAGE_LIBV4L_UTILS=y
BR2_PACKAGE_WIRINGPI=y
BR2_PACKAGE_NCURSES_WCHAR=y
BR2_PACKAGE_NCURSES_TARGET_PROGS=y
BR2_PACKAGE_AUTOSSH=y
BR2_PACKAGE_CONNMAN=y
BR2_PACKAGE_CONNMAN_WIFI=y
BR2_PACKAGE_CONNMAN_BLUETOOTH=y
BR2_PACKAGE_DHCPCD=y
BR2_PACKAGE_DROPBEAR=y
BR2_PACKAGE_HOSTAPD=y
BR2_PACKAGE_HOSTAPD_DRIVER_WIRED=y
BR2_PACKAGE_IW=y
BR2_PACKAGE_NTP=y
BR2_PACKAGE_OPENSSH=y
BR2_PACKAGE_PUTTY=y
BR2_PACKAGE_SSHPASS=y
BR2_PACKAGE_WIRELESS_TOOLS=y
BR2_PACKAGE_WIRELESS_TOOLS_LIB=y
BR2_PACKAGE_WPA_SUPPLICANT_AP_SUPPORT=y
BR2_PACKAGE_WPA_SUPPLICANT_WIFI_DISPLAY=y
BR2_PACKAGE_WPA_SUPPLICANT_CLI=y
BR2_PACKAGE_WPA_SUPPLICANT_WPA_CLIENT_SO=y
BR2_PACKAGE_WPA_SUPPLICANT_PASSPHRASE=y
BR2_PACKAGE_SCREEN=y
BR2_PACKAGE_SUDO=y
BR2_PACKAGE_TIME=y
BR2_PACKAGE_WHICH=y
BR2_PACKAGE_HTOP=y
BR2_PACKAGE_KMOD=y
BR2_PACKAGE_UTIL_LINUX_LIBBLKID=y
BR2_PACKAGE_UTIL_LINUX_RFKILL=y
BR2_PACKAGE_VIM=y
BR2_TARGET_ROOTFS_EXT2=y
BR2_TARGET_ROOTFS_EXT2_4=y
BR2_TARGET_ROOTFS_EXT2_SIZE="1000M"
BR2_PACKAGE_HOST_CMAKE=y
BR2_PACKAGE_HOST_DOSFSTOOLS=y
BR2_PACKAGE_HOST_GENIMAGE=y
BR2_PACKAGE_HOST_MTOOLS=y
BR2_PACKAGE_AESD_ASSIGNMENTS=y
BR2_PACKAGE_DLIB=y
BR2_PACKAGE_DLIB_GUI_SUPPORT=y
BR2_PACKAGE_DLIB_PYTHON_MODULE=y
BR2_PACKAGE_DISTRO=y
BR2_PACKAGE_WHEEL=y
BR2_PACKAGE_PYPARSING=y
BR2_PACKAGE_SOCKETTEST=y
BR2_PACKAGE_QT_THREAD_UPDATER=y
BR2_PACKAGE_PYTHON_FACE_RECOGNITION=y
BR2_PACKAGE_PYTHON_GLOB2=y
BR2_PACKAGE_PYTHON_GPSDCLIENT=y
BR2_PACKAGE_PYTHON_OBD=y
BR2_PACKAGE_PYTHON_PYQT5_SIP=y
BR2_PACKAGE_PYTHON_PYQT_BUILDER=y
BR2_PACKAGE_PYTHON_PYQTGRAPH=y
BR2_PACKAGE_PYTHON_QTPY=y
BR2_PACKAGE_PYTHON_QUEUELIB=y
BR2_PACKAGE_PYTHON_SCIKIT_BUILD=y
BR2_PACKAGE_PYTHON_SOCKETS=y
BR2_PACKAGE_PYTHON_THREAD6=y
BR2_PACKAGE_PYTHON_THREADING2=y
```

## final-project-saloni1307-master/base_external/package/distro/Config.in
```kconfig
config BR2_PACKAGE_DISTRO
	bool "distro"
	help
	  Includes the distro package for python.
```

## final-project-saloni1307-master/base_external/package/dlib/Config.in
```kconfig
config BR2_PACKAGE_DLIB
	bool "dlib"
	depends on BR2_INSTALL_LIBSTDCPP
	depends on BR2_TOOLCHAIN_HAS_THREADS
	depends on !BR2_TOOLCHAIN_HAS_GCC_BUG_64735 # exception_ptr
	select BR2_PACKAGE_JPEG
	select BR2_PACKAGE_LIBPNG
	help
	  Dlib is a modern C++ toolkit containing machine learning
	  algorithms and tools for creating complex software in C++
	  to solve real world problems. It is used in both industry
	  and academia in a wide range of domains including robotics,
	  embedded devices, mobile phones, and large high performance
	  computing environments. Dlib's open source licensing allows
	  you to use it in any application, free of charge.

	  http://dlib.net

if BR2_PACKAGE_DLIB

config BR2_PACKAGE_DLIB_GUI_SUPPORT
	bool "dlib GUI support"
	depends on BR2_PACKAGE_XORG7
	select BR2_PACKAGE_XLIB_LIBXEXT
	help
	  This option enable the GUI widgets using X.Org.

comment "dlib GUI support needs X.Org"
	depends on !BR2_PACKAGE_XORG7

config BR2_PACKAGE_DLIB_PYTHON_MODULE
	bool "python-dlib"
	depends on BR2_PACKAGE_PYTHON || BR2_PACKAGE_PYTHON3
	help
	  This option provide the dlib python module.

endif

comment "dlib needs a toolchain w/ C++, threads"
	depends on !BR2_INSTALL_LIBSTDCPP || !BR2_TOOLCHAIN_HAS_THREADS

comment "dlib needs exception_ptr"
	depends on BR2_TOOLCHAIN_HAS_GCC_BUG_64735
```

## final-project-saloni1307-master/base_external/package/eye-game/Config.in
```kconfig
config BR2_PACKAGE_EYE_GAME
	bool "eye-game"
	help
	  Includes the eye-game package for python.
```

## final-project-saloni1307-master/base_external/package/pyparsing/Config.in
```kconfig
config BR2_PACKAGE_PYPARSING
	bool "pyparsing"
	help
	  Includes the pyparsing package for python.
```

## final-project-saloni1307-master/base_external/package/python-face-recognition-models/Config.in
```kconfig
config BR2_PACKAGE_PYTHON_FACE_RECOGNITION_MODELS
	bool "python-face-recognition-models"
	help
	  Models used by the face_recognition package.

	  https://github.com/ageitgey/face_recognition_models
```

## final-project-saloni1307-master/base_external/package/python-face-recognition/Config.in
```kconfig
config BR2_PACKAGE_PYTHON_FACE_RECOGNITION
	bool "python-face-recognition"
	select BR2_PACKAGE_PYTHON_CLICK # runtime
	select BR2_PACKAGE_PYTHON_DLIB # runtime
	select BR2_PACKAGE_PYTHON_FACE_RECOGNITION_MODELS # runtime
	select BR2_PACKAGE_PYTHON_NUMPY # runtime
	select BR2_PACKAGE_PYTHON_PILLOW # runtime
	help
	  Recognize faces from Python or from the command line.

	  https://github.com/ageitgey/face_recognition
```

## final-project-saloni1307-master/base_external/package/python-glob2/Config.in
```kconfig
config BR2_PACKAGE_PYTHON_GLOB2
	bool "python-glob2"
	help
	  Version of the glob module that can capture patterns and
	  supports recursive wildcards.

	  http://github.com/miracle2k/python-glob2/
```

## final-project-saloni1307-master/base_external/package/python-obd/Config.in
```kconfig
config BR2_PACKAGE_PYTHON_OBD
	bool "python-obd"
	select BR2_PACKAGE_PYTHON_PINT # runtime
	select BR2_PACKAGE_PYTHON_PYSERIAL # runtime
	help
	  Serial module for handling live sensor data from a
	  vehicle's OBD-II port.

	  http://github.com/brendan-w/python-OBD
```

## final-project-saloni1307-master/base_external/package/python-opencv-python/Config.in
```kconfig
config BR2_PACKAGE_PYTHON_OPENCV_PYTHON
	bool "python-opencv-python"
	select BR2_PACKAGE_ # runtime
	select BR2_PACKAGE_ # runtime
	select BR2_PACKAGE_ # runtime
	select BR2_PACKAGE_ # runtime
	select BR2_PACKAGE_PYTHON_1 # runtime
	select BR2_PACKAGE_PYTHON_1 # runtime
	select BR2_PACKAGE_PYTHON_3 # runtime
	select BR2_PACKAGE_PYTHON_7 # runtime
	select BR2_PACKAGE_PYTHON_M # runtime
	select BR2_PACKAGE_PYTHON_N # runtime
	select BR2_PACKAGE_PYTHON_P # runtime
	select BR2_PACKAGE_PYTHON_U # runtime
	select BR2_PACKAGE_PYTHON_Y # runtime
	help
	  Wrapper package for OpenCV python bindings.

	  https://github.com/skvark/opencv-python
```

## final-project-saloni1307-master/base_external/package/python-pyqt-builder/Config.in
```kconfig
config BR2_PACKAGE_PYTHON_PYQT_BUILDER
	bool "python-pyqt-builder"
	select BR2_PACKAGE_PYTHON_PACKAGING # runtime
	select BR2_PACKAGE_PYTHON_SIP # runtime
	help
	  The PEP 517 compliant PyQt build system.

	  https://www.riverbankcomputing.com/software/pyqt-builder/
```

## final-project-saloni1307-master/base_external/package/python-pyqt5-sip/Config.in
```kconfig
config BR2_PACKAGE_PYTHON_PYQT5_SIP
	bool "python-pyqt5-sip"
	help
	  The sip module support for PyQt5.

	  https://www.riverbankcomputing.com/software/sip/
```

## final-project-saloni1307-master/base_external/package/python-pyqtgraph/Config.in
```kconfig
config BR2_PACKAGE_PYTHON_PYQTGRAPH
	bool "python-pyqtgraph"
	select BR2_PACKAGE_PYTHON_NUMPY # runtime
	help
	  Scientific Graphics and GUI Library for Python.

	  http://www.pyqtgraph.org
```

## final-project-saloni1307-master/base_external/package/python-qtpy/Config.in
```kconfig
config BR2_PACKAGE_PYTHON_QTPY
	bool "python-qtpy"
	help
	  Provides an abstraction layer on top of the various Qt
	  bindings (PyQt5, PyQt4 and PySide) and additional custom
	  QWidgets.

	  https://github.com/spyder-ide/qtpy
```

## final-project-saloni1307-master/base_external/package/python-queuelib/Config.in
```kconfig
config BR2_PACKAGE_PYTHON_QUEUELIB
	bool "python-queuelib"
	help
	  Collection of persistent (disk-based) and non-persistent
	  (memory-based) queues.

	  https://github.com/scrapy/queuelib
```

## final-project-saloni1307-master/base_external/package/python-scikit-build/Config.in
```kconfig
config BR2_PACKAGE_PYTHON_SCIKIT_BUILD
	bool "python-scikit-build"
	select BR2_PACKAGE_PYTHON_DISTRO # runtime
	select BR2_PACKAGE_PYTHON_PACKAGING # runtime
	select BR2_PACKAGE_PYTHON_SETUPTOOLS # runtime
	select BR2_PACKAGE_PYTHON_SETUPTOOLS # runtime
	select BR2_PACKAGE_PYTHON_WHEEL # runtime
	help
	  Improved build system generator for Python
	  C/C++/Fortran/Cython extensions.

	  https://github.com/scikit-build/scikit-build
```

## final-project-saloni1307-master/base_external/package/python-sockets/Config.in
```kconfig
config BR2_PACKAGE_PYTHON_SOCKETS
	bool "python-sockets"
	help
	  Python package which allows creation of simple servers and
	  clients for communication with sockets.

	  https://github.com/eshiofune/sockets
```
