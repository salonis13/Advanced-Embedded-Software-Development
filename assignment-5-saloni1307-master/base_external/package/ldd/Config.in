## final-project-saloni1307-master/base_external/package/python-thread6/Config.in
```kconfig
config BR2_PACKAGE_PYTHON_THREAD6
	bool "python-thread6"
	help
	  A plug n play multithreading interface.

	  https://github.com/Haizzz/thread6
```

## final-project-saloni1307-master/base_external/package/python-threading2/Config.in
```kconfig
config BR2_PACKAGE_PYTHON_THREADING2
	bool "python-threading2"
	help
	  A multithreading interface.
```

## final-project-saloni1307-master/base_external/package/qt-thread-updater/Config.in
```kconfig
config BR2_PACKAGE_QT_THREAD_UPDATER
	bool "qt-thread-updater"
	help
	  Includes the qt-thread-updater package for python.
```

## final-project-saloni1307-master/base_external/package/wheel/Config.in
```kconfig
config BR2_PACKAGE_WHEEL
	bool "wheel"
	help
	  Includes the wheel package for python.
```
